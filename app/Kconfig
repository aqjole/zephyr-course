## app/Kconfig
```kconfig
menuconfig APP_LED
	bool "LED Subsystem"
	default y
	help
	  Enable the application's LED blink subsystem.

if APP_LED

choice APP_LED_BLINK_SLEEP
	prompt "LED blink sleep time"
	default APP_LED_BLINK_SLEEP_1S

config APP_LED_BLINK_SLEEP_250MS
	bool "250ms (fast)"

config APP_LED_BLINK_SLEEP_500MS
	bool "500ms"

config APP_LED_BLINK_SLEEP_1S
	bool "1s (medium)"

config APP_LED_BLINK_SLEEP_2S
	bool "2s (slow)"

endchoice

# Hidden symbol (no prompt): derived from the choice above.
config APP_LED_BLINK_SLEEP_MS
	int
	default 250 if APP_LED_BLINK_SLEEP_250MS
	default 500 if APP_LED_BLINK_SLEEP_500MS
	default 1000 if APP_LED_BLINK_SLEEP_1S
	default 2000 if APP_LED_BLINK_SLEEP_2S

menuconfig APP_LED_ADVANCED
	bool "Advanced LED settings"
	help
	  Show advanced LED tuning options.

if APP_LED_ADVANCED

config APP_LED_BRIGHTNESS
	int "LED brightness (0-100)"
	range 0 100
	default 100

config APP_LED_FADE_DURATION_MS
	int "LED fade duration (ms)"
	range 0 5000
	default 500

menu "Expert settings"
	visible if APP_LED_ADVANCED

config APP_LED_DEBUG
	bool "Enable LED debugging"
	help
	  Log extra details about every LED toggle.

config APP_LED_CUSTOM_PATTERN
	bool "Custom blink pattern"
	help
	  Use a custom blink pattern instead of a fixed period.

endmenu

endif # APP_LED_ADVANCED

endif # APP_LED

source "Kconfig.zephyr"
```

## boards/esp32s3_custom/board.yml
```yaml
board:
  name: esp32s3_custom
  full_name: ESP32-S3-Custom
  vendor: espressif
  socs:
  - name: esp32s3
```

## boards/esp32s3_minimal/board.yml
```yaml
board:
  name: esp32s3_minimal
  full_name: ESP32-S3 Minimal
  vendor: espressif
  socs:
    - name: esp32s3
```

## drivers/led_sensor/Kconfig
```kconfig
menuconfig LED_SENSOR
	bool "LED Sensor Driver"
	default y
	depends on DT_HAS_ZEPHYR_LED_SENSOR_ENABLED
	select GPIO
	help
	  Sensor driver for a simple on-board LED. sensor_sample_fetch()
	  turns the LED on and sensor_channel_get() turns it off.
```

## dts/bindings/sensor/zephyr,led-sensor.yaml
```yaml
description: Simple on-board LED exposed as a sensor

compatible: "zephyr,led-sensor"

include: sensor-device.yaml

properties:
  gpios:
    type: phandle-array
    required: true
    description: GPIO the LED is connected to
```
